#include "mt7621_doonink_fw40.dtsi"

/ {
	compatible = "doonink,fw40-32m", "doonink,fw40", "mediatek,mt7621-soc";
	model = "Doonink FW40 (32M)";
};

&flash0 {
	broken-flash-reset;
};

&firmware {
	reg = <0x50000 0x1fb0000>;
};
